## layers/meta-vinotion/conf/layer.conf
```bitbake
# We have a conf and classes directory, add to BBPATH
BBPATH .= ":${LAYERDIR}"

# We have recipes-* directories, add to BBFILES
BBFILES += "${LAYERDIR}/recipes-*/*/*.bb \
            ${LAYERDIR}/recipes-*/*/*.bbappend"

BBFILE_COLLECTIONS += "meta-vinotion"
BBFILE_PATTERN_meta-vinotion = "^${LAYERDIR}/"
BBFILE_PRIORITY_meta-vinotion = "6"

LAYERDEPENDS_meta-vinotion = "core"
LAYERSERIES_COMPAT_meta-vinotion = "dunfell"
```
